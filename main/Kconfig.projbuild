## main/Kconfig.projbuild
```kconfig
menu "esp32_addon_bootloader - module selection"
	    choice MODULE_TYPE
                prompt "Module type"
            help
                Specify the module type (Arduino Nano RP2040 Connect or esp32miniBT module).
                
            config MODULE_MINIBT
                bool "esp32miniBT module"

            config MODULE_NANO
                bool "Arduino Nano Connect RP2040 with uBlox Nina"
            endchoice
endmenu
```

## sdkconfig.defaults
```kconfig
# for testing with ESP32Think (Sparkfun), which has a different XTAl
CONFIG_ESP32_XTAL_FREQ_AUTO=y
CONFIG_ESP32_XTAL_FREQ=0

# Nina module on Arduino Nano Connect RP2040 uses 2MB
CONFIG_ESPTOOLPY_FLASHSIZE_2MB=y
CONFIG_ESPTOOLPY_FLASHSIZE="2MB"
CONFIG_ESPTOOLPY_FLASHSIZE_DETECT=y

# flash with 115.2k by default (used by the serialpassthrough sketch)
CONFIG_ESPTOOLPY_BAUD_115200B=y
CONFIG_ESPTOOLPY_BAUD=115200

# disable logging to use UART0 for downloading
CONFIG_LOG_DEFAULT_LEVEL_NONE=y
CONFIG_LOG_DEFAULT_LEVEL=0

CONFIG_ESP_CONSOLE_NONE=y
CONFIG_ESP_CONSOLE_UART_NUM=-1

# if we want to flash via serial passthrough sketch on RP2040, no reset here.
CONFIG_ESPTOOLPY_BEFORE_NORESET=y
CONFIG_ESPTOOLPY_BEFORE="no_reset"
CONFIG_ESPTOOLPY_AFTER_RESET=y

CONFIG_PARTITION_TABLE_CUSTOM=y
CONFIG_PARTITION_TABLE_CUSTOM_FILENAME="partitions.csv"
CONFIG_PARTITION_TABLE_FILENAME="partitions.csv"
CONFIG_PARTITION_TABLE_OFFSET=0x8000
CONFIG_PARTITION_TABLE_MD5=y
```
